## drivers/misc/mediatek/cam_cal/Kconfig
```kconfig
config MTK_CAM_CAL
  bool CONFIG_MTK_CAM_CAL
  default n
  help
    CONFIG_MTK_CAM_CAL define if the camera cal driver should be built in or not

#
# Camera EEPROM Calibration
#
config MTK_CAM_CAL_GT24C32A_SUPPORT
       bool "GT24C32A EEPROM Driver"
       default n

config MTK_CAM_CAL_CAT24C16_SUPPORT
       bool "CAT24C16 EEPROM Driver"
       default n
```
